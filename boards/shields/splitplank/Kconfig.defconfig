## boards/shields/splitplank/Kconfig.defconfig
```kconfig
if SHIELD_SPLITPLANK_LEFT

config ZMK_KEYBOARD_NAME
    default "Plank Split"

config ZMK_SPLIT_ROLE_CENTRAL
    default y

endif

if SHIELD_SPLITPLANK_LEFT || SHIELD_SPLITPLANK_RIGHT

config ZMK_SPLIT
    default y

endif
```

## boards/shields/splitplank/Kconfig.shield
```kconfig
# Copyright (c) 2020 Pete Johanson
# SPDX-License-Identifier: MIT

config SHIELD_SPLITPLANK_LEFT
    def_bool $(shields_list_contains,splitplank_left)

config SHIELD_SPLITPLANK_RIGHT
    def_bool $(shields_list_contains,splitplank_right)
```
